#include <SPI.h>

// pins
int slaveSelectPin = 10;
int rstPin = 6;
int dcPin = 5;

// constants
int divider = 84;
int maxBufferIndex = 504;

// buffer
char screenBuffer[504];

// ASCII data
unsigned char font[95][6] =
    {
        { 0x00, 0x00, 0x00, 0x00, 0x00, 0x00 }, // space
        { 0x00, 0x00, 0x5F, 0x00, 0x00, 0x00 }, // !
        { 0x00, 0x07, 0x00, 0x07, 0x00, 0x00 }, // "
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        { 0x10, 0x08, 0x08, 0x10, 0x08, 0x00 } // ~
    };

void setup()
{
    Serial.begin(9600);
    
    // intialize SPI
    SPI.begin(slaveSelectPin);
    SPI.setClockDivider(slaveSelectPin, divider);
    
    // initialize pins
    pinMode(dcPin, OUTPUT);
    pinMode(rstPin, OUTPUT);
    
    // initial reset of display
    resetDisplay();
    
    // initialization of display
    digitalWrite(dcPin, LOW);
    SPI.transfer(slaveSelectPin, 0x21);
    SPI.transfer(slaveSelectPin, 0x14);
    SPI.transfer(slaveSelectPin, 0xb0);
    SPI.transfer(slaveSelectPin, 0x20);
    SPI.transfer(slaveSelectPin, 0x0c);
    digitalWrite(dcPin, HIGH);
    
    // initialize screen buffer
    resetBuffer();
}

/**
 * Loop function for main code
 */
void loop()
{
  printChar(20, 39, '@');
  flushBuffer();
}

/**
 * Resets display.
 */
void resetDisplay()
{
  digitalWrite(rstPin, LOW);
  delay(500);
  digitalWrite(rstPin, HIGH);
}

/**
 * Writes the screen buffer into the display.
 *
 * It does NOT reset the buffer.
 */
void flushBuffer()
{
  for (int i = 0; i < maxBufferIndex; i++) {
    SPI.transfer(slaveSelectPin, screenBuffer[i]);
  }
}

/**
 * Resets the buffer.
 *
 * Writes 0 in all fields.
 */
void resetBuffer()
{
  for (int i = 0; i < maxBufferIndex; i++) {
    screenBuffer[i] = 0x0;
  }
}

/**
 * Sets the pixel at the given location.
 * @param x
 * @param y
 * @param value
 */
void setPixel(int x, int y, int value)
{
  int bank = x / 8;
  int relativeRow = x - bank * 8;
  int bankStartIndex = bank * 84;
  int index = bankStartIndex + y;
  char bitValue = 0x0;
  
  Serial.print("x:");
  Serial.println(x);
  Serial.print("y:");
  Serial.println(y);
  Serial.print("value:");
  Serial.println(value);
  
  if (value == 1) {
    bitValue = 0xff;
  }
  
  char existingValue = screenBuffer[index];
  char pixelMask = 1 << relativeRow;
  pixelMask = 0x0 | pixelMask;
  char invMask = ~ pixelMask;
  char newValue = pixelMask & bitValue;
  
  char finalExistingValue = existingValue & invMask;
  char finalValue = finalExistingValue | newValue;
  screenBuffer[index] = finalValue;
}

/**
 * Prints given char at given location.
 *
 * @param x
 * @param y
 * @param value
 *
 * @return 0 on success, -1 otherwise
 */
int printChar(int x, int y, char value)
{
  // guardians
  if (x > 40 || y > 78) {
    // absolute guardian
    return -1;
  }
  // TODO relative guardian to existing buffer

  char space = ' ';
  int arrayIndex = value - space;

  for (int i = 0; i < 6; i++) {
    char data = font[arrayIndex][i];
    for (int _x = 0; _x < 8; _x++) {
      char bitmask = 1 << _x;
      bitmask = 0x0 | bitmask;
      char pixel = bitmask & data;
      int pixelInt = 0;
      if (pixel != 0x0) {
        pixelInt = 1;
      }
      setPixel(x + _x, y + i, pixelInt);
    }
  }

  return 0;
}
